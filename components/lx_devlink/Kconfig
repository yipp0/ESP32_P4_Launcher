## components/lx_devlink/Kconfig
```kconfig
menu "Launcher DevLink"
choice LX_DEVLINK_TRANSPORT
    prompt "DevLink serial transport"
    default LX_DEVLINK_USB_SERIAL_JTAG
config LX_DEVLINK_USB_SERIAL_JTAG
    bool "Native USB Serial/JTAG"
config LX_DEVLINK_UART
    bool "UART console (USB-to-UART bridge)"
    depends on ESP_CONSOLE_UART
endchoice
config LX_DEVLINK_UART_BAUDRATE
    int "DevLink UART baud rate"
    depends on LX_DEVLINK_UART
    range 115200 3000000
    default 921600
    help
        Host tools must use the same baud rate (--baud or PAPP_BAUD).
        Once DevLink starts, ESP_LOG messages on this console are framed
        instead of emitted as plain text, to avoid corrupting app uploads.
endmenu
```

## components/lx_net/Kconfig
```kconfig
menu "Launcher networking"
config LX_NET_DISABLED
    bool "Disable network coprocessor access (offline launcher)"
    default n
    help
        Report no radio without connecting the ESP-Hosted link or accessing its reset GPIO.
        For boards whose coprocessor still has incompatible factory firmware.
        SD apps, USB DevLink, display, touch and audio remain available.
config LX_HOSTED_DEFERRED_INIT
    bool "Start ESP-Hosted after board initialization"
    depends on !LX_NET_DISABLED
    default n
    help
        Suppress ESP-Hosted's global constructor and initialize it from
        lx_net_init, after the BSP sets up power, reset hooks and SD storage.
endmenu
```

## tools/c6_sdio/sdkconfig.defaults
```kconfig
CONFIG_IDF_TARGET="esp32p4"
CONFIG_SPIRAM=y
CONFIG_SPIRAM_MODE_HEX=y
CONFIG_SPIRAM_SPEED_200M=y
CONFIG_SPIRAM_USE_MALLOC=y
CONFIG_ESP32P4_SELECTS_REV_LESS_V3=y
CONFIG_ESP32P4_REV_MIN_100=y
CONFIG_ESPTOOLPY_FLASHSIZE_16MB=y
CONFIG_ESPTOOLPY_FLASHMODE_DIO=y
CONFIG_ESPTOOLPY_FLASHFREQ_80M=y
CONFIG_CACHE_L2_CACHE_128KB=y
CONFIG_ESP_CONSOLE_UART_DEFAULT=y
CONFIG_ESP_CONSOLE_UART_BAUDRATE=115200
CONFIG_PARTITION_TABLE_CUSTOM=y
CONFIG_PARTITION_TABLE_CUSTOM_FILENAME="../../launcher/partitions.csv"
CONFIG_FATFS_LFN_HEAP=y
CONFIG_FATFS_MAX_LFN=255
CONFIG_SERIAL_FLASHER_LOG_LEVEL_INFO=y
```
